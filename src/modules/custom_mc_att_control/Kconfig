## src/modules/custom_mc_att_control/Kconfig
```kconfig
menuconfig MODULES_CUSTOM_MC_ATT_CONTROL
    bool "custom_mc_att_control"
    default n
    ---help---
        Enable support for custom minimal attitude controller.

        This is a simplified attitude controller designed for research
        and educational purposes. It provides basic PID attitude control
        optimized for Gazebo X500.
```

## src/modules/custom_mc_rate_control/Kconfig
```kconfig
menuconfig MODULES_CUSTOM_MC_RATE_CONTROL
    bool "custom_mc_rate_control"
    default n
    ---help---
        Enable support for a minimal custom multicopter rate controller.

        This module provides a lightweight rate controller intended for
        aggressive maneuvering, where arbitrary torque vectoring is
        required and additional filtering is undesirable.
```

## src/modules/test_filter/Kconfig
```kconfig
menuconfig MODULES_TEST_FILTER
	bool "test_filter"
	default n
	---help---
		Enable support for test_filter - Simple complementary filter for attitude estimation
```

## src/modules/testing_control/Kconfig
```kconfig
menuconfig MODULES_TESTING_CONTROL
	bool "testing_control"
	default n
	---help---
		Enable support for testing_control

menuconfig USER_TESTING_CONTROL
	bool "testing_control running as userspace module"
	default n
	depends on BOARD_PROTECTED && MODULES_TESTING_CONTROL
	---help---
		Put testing_control in userspace memory
```
