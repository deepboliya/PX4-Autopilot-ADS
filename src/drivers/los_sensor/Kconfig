## src/drivers/los_sensor/Kconfig
```kconfig
menuconfig DRIVERS_LOS_SENSOR
    bool "LOS Sensor Driver"
    default n
    ---help---
        Custom UART LOS sensor driver
```

## src/modules/custom_mc_pos_control/Kconfig
```kconfig
menuconfig MODULES_CUSTOM_MC_POS_CONTROL
	bool "custom_mc_pos_control"
	default n
	---help---
		Enable support for custom minimal position controller.

		This is a simplified position controller designed for research
		and educational purposes. It provides basic cascaded P-PID
		position/velocity control optimized for Gazebo X500.

		Features:
		- Position P-control for velocity setpoint generation
		- Velocity PID control for acceleration/thrust generation
		- Simplified thrust-to-attitude conversion
		- No VTOL support (pure quadcopter)
		- No goto control complexity
		- Minimal parameter set
```

## src/modules/flip_rig/Kconfig
```kconfig
menuconfig MODULES_FLIP_RIG
	bool "flip_rig"
	default n
	---help---
		Enable support for flip_rig

		Standalone, manually-started single-shot 360 degree flip
		controller for a fixture that physically prevents translation
		(e.g. a 3-axis gimbal/gyroscope test rig). Never touches position/
		GPS - start with `flip_rig start` and do not run it alongside
		another OFFBOARD-publishing module. The instant OFFBOARD is
		engaged, it latches the vehicle's current yaw, executes exactly
		one 360 degree roll via raw body-rate setpoints, then commands a
		level attitude at the latched yaw and holds it.
```

## src/modules/flip_rig_axis/Kconfig
```kconfig
menuconfig MODULES_FLIP_RIG_AXIS
	bool "flip_rig_axis"
	default n
	---help---
		Enable support for flip_rig_axis

		Standalone, manually-started single-shot 360 degree flip
		controller for a fixture that physically prevents translation
		(e.g. a 3-axis gimbal/gyroscope test rig), driven through the
		ATTITUDE setpoint path (mc_att_control) instead of raw body
		rates. Generalises flip_rig_pitch_att: the rotation axis is a
		free parameter anywhere in the body xy-plane (FRIGAX_AXIS), so
		the same module performs roll flips, pitch flips, and any
		diagonal in between. Never touches position/GPS - start with
		`flip_rig_axis start` and do not run it alongside another
		OFFBOARD-publishing module. The instant OFFBOARD is engaged it
		latches the vehicle's current yaw, executes exactly one 360
		degree rotation about the chosen axis by chasing a
		continuously-advancing attitude setpoint, then commands a level
		attitude at the latched yaw and holds it.
```

## src/modules/flip_rig_pitch/Kconfig
```kconfig
menuconfig MODULES_FLIP_RIG_PITCH
	bool "flip_rig_pitch"
	default n
	---help---
		Enable support for flip_rig_pitch

		Standalone, manually-started single-shot 360 degree pitch flip
		controller for a fixture that physically prevents translation
		(e.g. a 3-axis gimbal/gyroscope test rig). Never touches position/
		GPS - start with `flip_rig_pitch start` and do not run it alongside
		another OFFBOARD-publishing module. The instant OFFBOARD is
		engaged, it latches the vehicle's current yaw, executes exactly
		one 360 degree pitch rotation via raw body-rate setpoints, then
		commands a level attitude at the latched yaw and holds it.
```

## src/modules/flip_rig_pitch_att/Kconfig
```kconfig
menuconfig MODULES_FLIP_RIG_PITCH_ATT
	bool "flip_rig_pitch_att"
	default n
	---help---
		Enable support for flip_rig_pitch_att

		Standalone, manually-started single-shot 360 degree pitch flip
		controller for a fixture that physically prevents translation
		(e.g. a 3-axis gimbal/gyroscope test rig), driven through the
		ATTITUDE setpoint path (mc_att_control) instead of raw body
		rates. Never touches position/GPS - start with
		`flip_rig_pitch_att start` and do not run it alongside another
		OFFBOARD-publishing module. The instant OFFBOARD is engaged, it
		latches the vehicle's current yaw, executes exactly one 360
		degree pitch rotation by chasing a continuously-advancing
		attitude setpoint, then commands a level attitude at the
		latched yaw and holds it.
```

## src/modules/hold_rig_att/Kconfig
```kconfig
menuconfig MODULES_HOLD_RIG_ATT
	bool "hold_rig_att"
	default n
	---help---
		Enable support for hold_rig_att

		Standalone, manually-started controller that ramps the vehicle
		to an arbitrary commanded 3D attitude and holds it there, for a
		fixture that physically prevents translation (e.g. a 3-axis
		gimbal/gyroscope test rig). Driven through the ATTITUDE setpoint
		path (mc_att_control) instead of raw body rates. The
		standing-still counterpart to flip_rig_axis: that module rotates
		through a revolution about a fixed axis, this one travels to one
		orientation and parks on it.

		The target is specified either as a tilt magnitude plus a tilt
		direction (HRATT_MODE 0, degenerate nowhere in 0-180 degrees) or
		as Euler roll and pitch (HRATT_MODE 1, which loses control of
		tilt near 90 degrees because Z-Y-X applies pitch about the
		already-rolled axis). Ramping rather than stepping is what makes
		large angles safe: a static setpoint saturates MC_ROLLRATE_MAX
		past only ~57 degrees of error.

		Never touches position/GPS - start with `hold_rig_att start` and
		do not run it alongside another OFFBOARD-publishing module.
		Requires FD_FAIL_R/FD_FAIL_P to be relaxed for holds past 60
		degrees; the module warns about that and several other failsafes
		at startup.
```

## src/modules/los_guidance/Kconfig
```kconfig
menuconfig MODULES_LOS_GUIDANCE
	bool "los_guidance"
	default n
	---help---
		Enable support for los_guidance

		Converts body-frame LOS bearings (alpha = yaw, beta = pitch) from a
		gimbal-mounted camera into a NED-frame acceleration setpoint and
		publishes the result via the OFFBOARD pipeline
		(offboard_control_mode + trajectory_setpoint), so that
		mc_pos_control consumes it when OFFBOARD is engaged.
```

## src/modules/los_guidance_target_tracking/Kconfig
```kconfig
menuconfig MODULES_LOS_GUIDANCE_TARGET_TRACKING
	bool "los_guidance_target_tracking"
	default n
	---help---
		Line of sight guidance and target tracking module. Uses LosMeasurements to control yaw and a servo.
```

## src/modules/los_measurements_listener/Kconfig
```kconfig
menuconfig MODULES_LOS_MEASUREMENTS_LISTENER
	bool "los_measurements_listener"
	default n
	---help---
		Enable support for los_measurements_listener
```

## src/modules/motor_rig_test/Kconfig
```kconfig
menuconfig MODULES_MOTOR_RIG_TEST
	bool "motor_rig_test"
	default n
	---help---
		Enable support for motor_rig_test

		Standalone, manually-started bench/ground-test tool that spins any
		combination of this quad's 4 motors, each at its own independently
		set thrust value (MRIGT_MOTORS bitmask selects the motors,
		MRIGT_M1_THR..MRIGT_M4_THR the per-motor values), through the same
		actuator_test override path as the `actuator_test` command. Only
		ever applies while disarmed - refuses to command anything if the
		vehicle is armed. Remove propellers before use. Start with
		`motor_rig_test start` and stop with `motor_rig_test stop` or by
		clearing MRIGT_MOTORS to 0.
```

## src/modules/target_follower/Kconfig
```kconfig
menuconfig MODULES_TARGET_FOLLOWER
	bool "target_follower"
	default n
	---help---
		Enable target_follower module.
```
